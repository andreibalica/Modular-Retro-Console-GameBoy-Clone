#include <avr/pgmspace.h>
#include "ssd1306.h"
#include "twi.h"

/* Font 5x8, caractere ASCII 0x20 - 0x7E, stocat in Flash */
static const uint8_t font5x8[][5] PROGMEM = {
    {0x00,0x00,0x00,0x00,0x00}, /* ' ' */
    {0x00,0x00,0x5F,0x00,0x00}, /* '!' */
    {0x00,0x07,0x00,0x07,0x00}, /* '"' */
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    {0x10,0x08,0x08,0x10,0x08}, /* '~' */
};

static void cmd(uint8_t c) {
    twi_start();
    twi_write(SSD1306_ADDR);
    twi_write(0x00);    /* control: command */
    twi_write(c);
    twi_stop();
}

static void data(uint8_t d) {
    twi_start();
    twi_write(SSD1306_ADDR);
    twi_write(0x40);    /* control: data */
    twi_write(d);
    twi_stop();
}

void ssd1306_init(void) {
    cmd(0xAE);          /* display off */
    cmd(0xD5); cmd(0x80);   /* clock */
    cmd(0xA8); cmd(0x3F);   /* multiplex 1/64 */
    cmd(0xD3); cmd(0x00);   /* display offset 0 */
    cmd(0x40);              /* start line 0 */
    cmd(0x8D); cmd(0x14);   /* charge pump on */
    cmd(0x20); cmd(0x00);   /* horizontal addressing */
    cmd(0xA1);              /* segment remap */
    cmd(0xC8);              /* COM scan direction */
    cmd(0xDA); cmd(0x12);   /* COM pins */
    cmd(0x81); cmd(0xCF);   /* contrast */
    cmd(0xD9); cmd(0xF1);   /* pre-charge */
    cmd(0xDB); cmd(0x40);   /* VCOMH */
    cmd(0xA4);              /* resume RAM content */
    cmd(0xA6);              /* normal display */
    cmd(0xAF);              /* display on */
}

void ssd1306_clear(void) {
    cmd(0x21); cmd(0); cmd(127);    /* col 0-127 */
    cmd(0x22); cmd(0); cmd(7);      /* page 0-7 */
    for (uint16_t i = 0; i < SSD1306_W * SSD1306_H / 8; i++)
        data(0x00);
}

void ssd1306_set_cursor(uint8_t col, uint8_t page) {
    cmd(0x21); cmd(col); cmd(127);
    cmd(0x22); cmd(page); cmd(7);
}

void ssd1306_write_char(char c) {
    if (c < 0x20 || c > 0x7E) c = '?';
    const uint8_t *glyph = font5x8[c - 0x20];
    for (uint8_t i = 0; i < 5; i++)
        data(pgm_read_byte(&glyph[i]));
    data(0x00);     /* spatiu intre caractere */
}

void ssd1306_write_string(const char *s) {
    while (*s)
        ssd1306_write_char(*s++);
}

void ssd1306_fill_screen(uint8_t color) {
    cmd(0x21); cmd(0); cmd(127);
    cmd(0x22); cmd(0); cmd(7);
    uint8_t fill = color ? 0xFF : 0x00;
    for (uint16_t i = 0; i < 1024; i++)
        data(fill);
}

/* Scrie 8 bytes (o coloana completa de 64px) la pozitia x, batched I2C */
void ssd1306_write_col(uint8_t x, const uint8_t data8[8]) {
    /* Set column window: x..x, page window: 0..7 */
    twi_start();
    twi_write(SSD1306_ADDR);
    twi_write(0x00);         /* multiple commands */
    twi_write(0x21); twi_write(x); twi_write(x);
    twi_write(0x22); twi_write(0); twi_write(7);
    twi_stop();
    /* Write 8 data bytes in one transaction */
    twi_start();
    twi_write(SSD1306_ADDR);
    twi_write(0x40);         /* data stream */
    for (uint8_t i = 0; i < 8; i++)
        twi_write(data8[i]);
    twi_stop();
}

/* Deseneaza o celula 8x8 la pozitia grid (gx, gy)
 * Celulele se aliniaza perfect cu paginile SSD1306 — fara framebuffer */
void ssd1306_fill_cell(uint8_t gx, uint8_t gy, uint8_t color) {
    cmd(0x21); cmd(gx * 8); cmd(gx * 8 + 7);
    cmd(0x22); cmd(gy);     cmd(gy);
    uint8_t fill = color ? 0xFF : 0x00;
    for (uint8_t i = 0; i < 8; i++)
        data(fill);
}
